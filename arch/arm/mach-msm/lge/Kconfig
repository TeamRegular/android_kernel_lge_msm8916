## arch/arm/mach-msm/lge/Kconfig
```kconfig
config MACH_LGE
	bool

menu "LGE Board Selection"

config MACH_MSM8916_C50_MPCS_US
        bool "MSM8916 C50_MPCS_US"
        depends on ARCH_MSM8916
        select MACH_LGE
        select LGE_ENABLE_THERMAL_CORE_CONTROL
        help
          Support for the Qualcomm MSM8916 C50 MPCS device.

config MACH_MSM8916_C50_TMO_US
        bool "MSM8916 C50_TMO_US"
        depends on ARCH_MSM8916
        select MACH_LGE
        select LGE_ENABLE_THERMAL_CORE_CONTROL
        help
          Support for the Qualcomm MSM8916 C50 TMO device.

config MACH_MSM8916_G4STYLUSN_MPCS_US
        bool "MSM8916 G4STYLUSN_MPCS_US"
        depends on ARCH_MSM8916
        select MACH_LGE
        select LGE_ENABLE_THERMAL_CORE_CONTROL
        help
          Support for the Qualcomm MSM8916 G4STYLUSN MPCS device.

config MACH_MSM8916_G4STYLUSN_TMO_US
        bool "MSM8916 G4STYLUSN_TMO_US"
        depends on ARCH_MSM8916
        select MACH_LGE
        select LGE_ENABLE_THERMAL_CORE_CONTROL
        help
          Support for the Qualcomm MSM8916 G4STYLUSN TMO device.

endmenu

config DTS_TARGET
	string "DTS target dir"
	default "msm8916-c50_mpcs_us" if MACH_MSM8916_C50_MPCS_US
	default "msm8916-c50_tmo_us" if MACH_MSM8916_C50_TMO_US
	default "msm8916-g4stylusn_mpcs_us" if MACH_MSM8916_G4STYLUSN_MPCS_US
	default "msm8916-g4stylusn_tmo_us" if MACH_MSM8916_G4STYLUSN_TMO_US

	help
	  CONFIG_DTS_TARGET should be set to support appended dts.
	  ex) CONFIG_DTS_TARGET="msm8974-g2-kr".

menu "LGE Specific Patches"

config LGE_MODULE_DETECT
	bool "Enable Module detection"
	default n
	help
	Feature for read device maker id, like lcd or touch maker

config LGE_ENABLE_THERMAL_CORE_CONTROL
        bool "Thermal Core Control"
        default n
        help
          Enable Thermal Core control to prevent hot temperature (Temporal)

config LGE_PM_CONTROL_TSENS_CRITICAL_TEMPERATURE
	bool "Support tsens critical temperature contorol"
	default n
	help
	  change tsens critical temperature for Accelerated High Temperature & Humidity Test

menu "LGE Battery Profile"

config LGE_PM_BATTERY_CAPACITY_1900mAh
	bool "Support Battery Capacity : 1900mAh"
	default n
	depends on LGE_PM_BATTERY_PROFILE_DATA
	help
	  LGE battery capacity for 1900mAh

endmenu

endmenu
```

## drivers/nfc/Kconfig
```kconfig
#
# Near Field Communication (NFC) devices
#

menu "Near Field Communication (NFC) devices"
	depends on NFC
endmenu

config LGE_NFC
	bool "NFC Device Enabled for LGE"
	default n

config LGE_NFC_PN547_C2
	bool "PN547 C2 NFC driver"
	depends on I2C
	select CRC_CCITT
	default n
	---help---
	  Say yes if you want PN547 Near Field Communication driver.
	  This is for i2c connected version. If unsure, say N here.

	  To compile this driver as a module, choose m here. The module will
	  be called pn547.

config LGE_NFC_SET_IRQ_WAKEUP
	bool "NFC Set IRQ wakeup when NFC ON"
	default n
	---help---
	  Say yes if Set IRQ Wakeup NFC ON.
	  If unsure, say N here.

config NFC_PN533
	tristate "NXP PN533 USB driver"
	depends on USB
	help
	  NXP PN533 USB driver.
	  This driver provides support for NFC NXP PN533 devices.

	  Say Y here to compile support for PN533 devices into the
	  kernel or say M to compile it as module (pn533).

config NFC_WILINK
	tristate "Texas Instruments NFC WiLink driver"
	depends on TI_ST && NFC_NCI
	help
	  This enables the NFC driver for Texas Instrument's BT/FM/GPS/NFC
	  combo devices. This makes use of shared transport line discipline
	  core driver to communicate with the NFC core of the combo chip.

	  Say Y here to compile support for Texas Instrument's NFC WiLink driver
	  into the kernel or say M to compile it as module.

config NFC_MEI_PHY
	tristate "MEI bus NFC device support"
	depends on INTEL_MEI && NFC_HCI
	help
	  This adds support to use an mei bus nfc device. Select this if you
	  will use an HCI NFC driver for an NFC chip connected behind an
	  Intel's Management Engine chip.

	  If unsure, say N.

source "drivers/nfc/pn544/Kconfig"
source "drivers/nfc/microread/Kconfig"

config NFC_QNCI
	bool "Qualcomm NCI based NFC Controller Driver for qca199x"
	depends on I2C
	select CRC_CCITT
	default n
	help
	  This enables the NFC driver for QCA199x based devices.
	  This is for i2c connected version. NCI protocol logic
	  resides in the usermode and it has no other NFC dependencies.
```
